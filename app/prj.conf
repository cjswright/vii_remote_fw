## CMakeLists.txt
```
#-------------------------------------------------------------------------------
# Zephyr Example Application
#
# Copyright (c) 2021 Nordic Semiconductor ASA
# SPDX-License-Identifier: Apache-2.0

cmake_minimum_required(VERSION 3.13.1)
find_package(Zephyr REQUIRED HINTS $ENV{ZEPHYR_BASE})

project(app LANGUAGES C)

target_sources(app PRIVATE src/main.c src/hog.c)
```

## prj.conf
```kconfig
# Increased stack due to settings API usage
CONFIG_SYSTEM_WORKQUEUE_STACK_SIZE=2048

CONFIG_BT=y
CONFIG_LOG=y
CONFIG_BT_SMP=y
CONFIG_BT_PERIPHERAL=y
CONFIG_BT_DIS=y
CONFIG_BT_BAS=y
CONFIG_BT_DEVICE_NAME="Vii Remote"
CONFIG_BT_DEVICE_APPEARANCE=962

CONFIG_BT_SETTINGS=y
CONFIG_FLASH=y
CONFIG_FLASH_MAP=y
CONFIG_NVS=y
CONFIG_SETTINGS=y
CONFIG_MPU_ALLOW_FLASH_WRITE=y

CONFIG_GPIO=y

CONFIG_UART_ASYNC_API=y

CONFIG_RING_BUFFER=y
```

## boards/nrf52840dk_nrf52840.overlay
```dts
&arduino_serial {
    status = "okay";
};
```

## src/main.c
```c
/* main.c - Application main entry point */

/*
 * Copyright (c) 2016 Intel Corporation
 *
 * SPDX-License-Identifier: Apache-2.0
 */

#include <zephyr/types.h>
#include <stddef.h>
#include <string.h>
#include <errno.h>
#include <zephyr/sys/printk.h>
#include <zephyr/sys/byteorder.h>
#include <zephyr/kernel.h>

#include <zephyr/settings/settings.h>

#include <zephyr/bluetooth/bluetooth.h>
#include <zephyr/bluetooth/hci.h>
#include <zephyr/bluetooth/conn.h>
#include <zephyr/bluetooth/uuid.h>
#include <zephyr/bluetooth/gatt.h>

#include <zephyr/drivers/uart.h>
#include <zephyr/sys/ring_buffer.h>
#include <zephyr/logging/log.h>

#include "hog.h"

LOG_MODULE_REGISTER(vii_remote);


static const struct bt_data ad[] = {
	BT_DATA_BYTES(BT_DATA_FLAGS, (BT_LE_AD_GENERAL | BT_LE_AD_NO_BREDR)),
	BT_DATA_BYTES(BT_DATA_UUID16_ALL,
		      BT_UUID_16_ENCODE(BT_UUID_HIDS_VAL),
		      BT_UUID_16_ENCODE(BT_UUID_BAS_VAL)),
};

static const struct bt_data sd[] = {
	BT_DATA(BT_DATA_NAME_COMPLETE, CONFIG_BT_DEVICE_NAME, sizeof(CONFIG_BT_DEVICE_NAME) - 1),
};

static void connected(struct bt_conn *conn, uint8_t err)
{
	char addr[BT_ADDR_LE_STR_LEN];

	bt_addr_le_to_str(bt_conn_get_dst(conn), addr, sizeof(addr));

	if (err) {
		printk("Failed to connect to %s (%u)\n", addr, err);
		return;
	}

	printk("Connected %s\n", addr);

	if (bt_conn_set_security(conn, BT_SECURITY_L2)) {
		printk("Failed to set security\n");
	}
}

static void disconnected(struct bt_conn *conn, uint8_t reason)
{
	char addr[BT_ADDR_LE_STR_LEN];

	bt_addr_le_to_str(bt_conn_get_dst(conn), addr, sizeof(addr));

	printk("Disconnected from %s (reason 0x%02x)\n", addr, reason);
}

static void security_changed(struct bt_conn *conn, bt_security_t level,
			     enum bt_security_err err)
{
	char addr[BT_ADDR_LE_STR_LEN];

	bt_addr_le_to_str(bt_conn_get_dst(conn), addr, sizeof(addr));

	if (!err) {
		printk("Security changed: %s level %u\n", addr, level);
	} else {
		printk("Security failed: %s level %u err %d\n", addr, level,
		       err);
	}
}

BT_CONN_CB_DEFINE(conn_callbacks) = {
	.connected = connected,
	.disconnected = disconnected,
#if defined(CONFIG_BT_SMP)
	.security_changed = security_changed,
#endif
};

static void bt_ready(int err)
{
	if (err) {
		printk("Bluetooth init failed (err %d)\n", err);
		return;
	}

	printk("Bluetooth initialized\n");

	hog_init();

	if (IS_ENABLED(CONFIG_SETTINGS)) {
		settings_load();
	}

	err = bt_le_adv_start(BT_LE_ADV_CONN, ad, ARRAY_SIZE(ad), sd, ARRAY_SIZE(sd));
	if (err) {
		printk("Advertising failed to start (err %d)\n", err);
		return;
	}

	printk("Advertising successfully started\n");
}

static void auth_passkey_display(struct bt_conn *conn, unsigned int passkey)
{
	char addr[BT_ADDR_LE_STR_LEN];

	bt_addr_le_to_str(bt_conn_get_dst(conn), addr, sizeof(addr));

	printk("Passkey for %s: %06u\n", addr, passkey);
}

static void auth_cancel(struct bt_conn *conn)
{
	char addr[BT_ADDR_LE_STR_LEN];

	bt_addr_le_to_str(bt_conn_get_dst(conn), addr, sizeof(addr));

	printk("Pairing cancelled: %s\n", addr);
}

static struct bt_conn_auth_cb auth_cb_display = {
	.passkey_display = auth_passkey_display,
	.passkey_entry = NULL,
	.cancel = auth_cancel,
};


int16_t acc_xhp, acc_yhp, acc_zhp;
int16_t acc_xf, acc_yf, acc_zf;

/* x = 0.73; a0 = 1 - x, Q.8 */
int a0 = 26;
int b1 = -230;

int16_t rollf, pitchf, yawf;
int16_t rollf_hp, pitchf_hp, yawf_hp;

void
process_accel_data(uint8_t *buf, int len)
{
	if (buf[0] != 0x55)
	{
		printk("Invalid looking SOF: %x\n", buf[0]);
		return;
	}
	if (buf[1] != 0x51)
	{
		printk("Opcode not accel: %x\n", buf[1]);
		return;
	}

	int16_t x = 0, y = 0, z = 0;

	x = buf[2] | (buf[3] << 8);
	y = buf[4] | (buf[5] << 8);
	z = buf[6] | (buf[7] << 8);

	acc_xf = (x * a0 - b1 * acc_xf) >> 8;
	acc_xhp = x - acc_xf;
	acc_yf = (y * a0 - b1 * acc_yf) >> 8;
	acc_yhp = y - acc_yf;
	acc_zf = (z * a0 - b1 * acc_zf) >> 8;
	acc_zhp = z - acc_zf;

	printk("ACCEL x=%d y=%d z=%d\n", acc_xhp, acc_yhp, acc_zhp);
	//hog_update_xy(acc_yhp >> 4, acc_xhp >> 4);
}


void
process_angular_velocity_data(uint8_t *buf, int len)
{
	if (buf[0] != 0x55)
	{
		printk("Invalid looking SOF: %x\n", buf[0]);
		return;
	}
	if (buf[1] != 0x52)
	{
		printk("Opcode not angular velocity: %x\n", buf[1]);
		return;
	}

	int16_t x = 0, y = 0, z = 0;

	x = buf[2] | (buf[3] << 8);
	y = buf[4] | (buf[5] << 8);
	z = buf[6] | (buf[7] << 8);

	//printk("ANGULAR VEL x=%d y=%d z=%d\n", x, y, z);
	//hog_update_xy(x >> 3, y >> 3);
}


void
process_angle_data(uint8_t *buf, int len)
{
	if (buf[0] != 0x55)
	{
		printk("Invalid looking SOF: %x\n", buf[0]);
		return;
	}
	if (buf[1] != 0x53)
	{
		printk("Opcode not angle: %x\n", buf[1]);
		return;
	}

	int16_t roll = 0, pitch = 0, yaw = 0;

	roll = buf[2] | (buf[3] << 8);
	pitch = buf[4] | (buf[5] << 8);
	yaw = buf[6] | (buf[7] << 8);

	rollf = (roll * a0 - b1 * rollf) >> 8;
	rollf_hp = roll - rollf;
	pitchf = (pitch * a0 - b1 * pitchf) >> 8;
	pitchf_hp = pitch - pitchf;
	yawf = (yaw * a0 - b1 * yawf) >> 8;
	yawf_hp = yaw - yawf;

	//printk("ANGLE roll=%d pitch=%d yaw=%d\n", roll, pitch, yaw);
	hog_update_xy(-1 * yawf_hp >> 5, pitchf_hp >> 5);
}


#define NUM_BUFFERS 2
uint8_t buf[NUM_BUFFERS][11];
int buf_index;

RING_BUF_DECLARE(uart_data_buf, 4096);

void
process_uart(void)
{
	uint8_t data[256];
	int read;
	int i = 0;

	while (1)
	{
		read = ring_buf_peek(&uart_data_buf, data, sizeof(data));

		/* Sync for 0x55 */
		while (data[i] != 0x55 && i < read)
			i++;
		ring_buf_get(&uart_data_buf, NULL, i);

		if (i == read)
			return;

		/* Grab the packet */
		read = ring_buf_peek(&uart_data_buf, data, 11);
		if (read != 11)
			return;

		char opc = data[1];
		switch (opc)
		{
			case 0x51:
				process_accel_data(data, 11);
				break;

			case 0x52:
				process_angular_velocity_data(data, 11);
				break;

			case 0x53:
				process_angle_data(data, 11);
				break;

			case 0x54:
				// No idea?
				break;

			default:
				printk("Unknown opcode: %x\n", opc);
		}
		ring_buf_get(&uart_data_buf, NULL, 11);
	}
}


void uart_callback(const struct device *dev,
				   struct uart_event *evt,
				   void *user_data)
{
	switch (evt->type)
	{
		case UART_RX_RDY:
			/* Data in evt->data.rx.buf */
			ring_buf_put(&uart_data_buf, evt->data.rx.buf, evt->data.rx.len);
			process_uart();
			break;

		case UART_RX_BUF_REQUEST:
			//printk("UART_RX_BUF_REQUEST\n");
			buf_index = (buf_index + 1) % NUM_BUFFERS;
			uart_rx_buf_rsp(dev, buf[buf_index], sizeof(buf[buf_index]));
			break;

		case UART_RX_BUF_RELEASED:
			//printk("UART_RX_BUF_RELEASED\n");
			break;

		case UART_RX_STOPPED:
			printk("UART_RX_STOPPED reason=%d\n", evt->data.rx_stop.reason);
			break;

		case UART_RX_DISABLED:
			printk("UART_RX_DISABLED\n");
			break;

		default:
			printk("UART CB %d\n", evt->type);
			break;
	}
}

int main(void)
{
	int err;

	err = bt_enable(bt_ready);
	if (err) {
		printk("Bluetooth init failed (err %d)\n", err);
		return 0;
	}

	if (IS_ENABLED(CONFIG_SAMPLE_BT_USE_AUTHENTICATION)) {
		bt_conn_auth_cb_register(&auth_cb_display);
		printk("Bluetooth authentication callbacks registered.\n");
	}

	const struct device *serial = DEVICE_DT_GET(DT_NODELABEL(arduino_serial));
	err = uart_callback_set(serial, uart_callback, NULL);
	if (err != 0)
	{
		printk("Failed set callback: %d\n", err);
	}

	err = uart_rx_enable(serial, buf[0], sizeof(buf), SYS_FOREVER_US);
	if (err != 0)
	{
		printk("Failed to enable rx: %d\n", err);
	}

	return 0;
}
```

## src/hog.c
```c
/** @file
 *  @brief HoG Service sample
 */

/*
 * Copyright (c) 2016 Intel Corporation
 *
 * SPDX-License-Identifier: Apache-2.0
 */

#include <zephyr/types.h>
#include <zephyr/drivers/gpio.h>
#include <stddef.h>
#include <string.h>
#include <errno.h>
#include <zephyr/sys/printk.h>
#include <zephyr/sys/byteorder.h>
#include <zephyr/kernel.h>

#include <zephyr/bluetooth/bluetooth.h>
#include <zephyr/bluetooth/hci.h>
#include <zephyr/bluetooth/conn.h>
#include <zephyr/bluetooth/uuid.h>
#include <zephyr/bluetooth/gatt.h>

enum {
	HIDS_REMOTE_WAKE = BIT(0),
	HIDS_NORMALLY_CONNECTABLE = BIT(1),
};

struct hids_info {
	uint16_t version; /* version number of base USB HID Specification */
	uint8_t code; /* country HID Device hardware is localized for. */
	uint8_t flags;
} __packed;

struct hids_report {
	uint8_t id; /* report id */
	uint8_t type; /* report type */
} __packed;

static struct hids_info info = {
	.version = 0x0000,
	.code = 0x00,
	.flags = HIDS_NORMALLY_CONNECTABLE,
};

enum {
	HIDS_INPUT = 0x01,
	HIDS_OUTPUT = 0x02,
	HIDS_FEATURE = 0x03,
};

static struct hids_report input = {
	.id = 0x01,
	.type = HIDS_INPUT,
};

static uint8_t simulate_input;
static uint8_t ctrl_point;
static uint8_t report_map[] = {
	0x05, 0x01, /* Usage Page (Generic Desktop Ctrls) */
	0x09, 0x02, /* Usage (Mouse) */
	0xA1, 0x01, /* Collection (Application) */
	0x85, 0x01, /*	 Report Id (1) */
	0x09, 0x01, /*   Usage (Pointer) */
	0xA1, 0x00, /*   Collection (Physical) */
	0x05, 0x09, /*     Usage Page (Button) */
	0x19, 0x01, /*     Usage Minimum (0x01) */
	0x29, 0x03, /*     Usage Maximum (0x03) */
	0x15, 0x00, /*     Logical Minimum (0) */
	0x25, 0x01, /*     Logical Maximum (1) */
	0x95, 0x03, /*     Report Count (3) */
	0x75, 0x01, /*     Report Size (1) */
	0x81, 0x02, /*     Input (Data,Var,Abs,No Wrap,Linear,...) */
	0x95, 0x01, /*     Report Count (1) */
	0x75, 0x05, /*     Report Size (5) */
	0x81, 0x03, /*     Input (Const,Var,Abs,No Wrap,Linear,...) */
	0x05, 0x01, /*     Usage Page (Generic Desktop Ctrls) */
	0x09, 0x30, /*     Usage (X) */
	0x09, 0x31, /*     Usage (Y) */
	0x15, 0x81, /*     Logical Minimum (129) */
	0x25, 0x7F, /*     Logical Maximum (127) */
	0x75, 0x08, /*     Report Size (8) */
	0x95, 0x02, /*     Report Count (2) */
	0x81, 0x06, /*     Input (Data,Var,Rel,No Wrap,Linear,...) */
	0xC0,       /*   End Collection */
	0xC0,       /* End Collection */
};


static ssize_t read_info(struct bt_conn *conn,
			  const struct bt_gatt_attr *attr, void *buf,
			  uint16_t len, uint16_t offset)
{
	return bt_gatt_attr_read(conn, attr, buf, len, offset, attr->user_data,
				 sizeof(struct hids_info));
}

static ssize_t read_report_map(struct bt_conn *conn,
			       const struct bt_gatt_attr *attr, void *buf,
			       uint16_t len, uint16_t offset)
{
	return bt_gatt_attr_read(conn, attr, buf, len, offset, report_map,
				 sizeof(report_map));
}

static ssize_t read_report(struct bt_conn *conn,
			   const struct bt_gatt_attr *attr, void *buf,
			   uint16_t len, uint16_t offset)
{
	return bt_gatt_attr_read(conn, attr, buf, len, offset, attr->user_data,
				 sizeof(struct hids_report));
}

static void input_ccc_changed(const struct bt_gatt_attr *attr, uint16_t value)
{
	simulate_input = (value == BT_GATT_CCC_NOTIFY) ? 1 : 0;
}

static ssize_t read_input_report(struct bt_conn *conn,
				 const struct bt_gatt_attr *attr, void *buf,
				 uint16_t len, uint16_t offset)
{
	return bt_gatt_attr_read(conn, attr, buf, len, offset, NULL, 0);
}

static ssize_t write_ctrl_point(struct bt_conn *conn,
				const struct bt_gatt_attr *attr,
				const void *buf, uint16_t len, uint16_t offset,
				uint8_t flags)
{
	uint8_t *value = attr->user_data;

	if (offset + len > sizeof(ctrl_point)) {
		return BT_GATT_ERR(BT_ATT_ERR_INVALID_OFFSET);
	}

	memcpy(value + offset, buf, len);

	return len;
}

#if CONFIG_SAMPLE_BT_USE_AUTHENTICATION
/* Require encryption using authenticated link-key. */
#define SAMPLE_BT_PERM_READ BT_GATT_PERM_READ_AUTHEN
#define SAMPLE_BT_PERM_WRITE BT_GATT_PERM_WRITE_AUTHEN
#else
/* Require encryption. */
#define SAMPLE_BT_PERM_READ BT_GATT_PERM_READ_ENCRYPT
#define SAMPLE_BT_PERM_WRITE BT_GATT_PERM_WRITE_ENCRYPT
#endif

/* HID Service Declaration */
BT_GATT_SERVICE_DEFINE(hog_svc,
	BT_GATT_PRIMARY_SERVICE(BT_UUID_HIDS),
	BT_GATT_CHARACTERISTIC(BT_UUID_HIDS_INFO, BT_GATT_CHRC_READ,
			       BT_GATT_PERM_READ, read_info, NULL, &info),
	BT_GATT_CHARACTERISTIC(BT_UUID_HIDS_REPORT_MAP, BT_GATT_CHRC_READ,
			       BT_GATT_PERM_READ, read_report_map, NULL, NULL),
	BT_GATT_CHARACTERISTIC(BT_UUID_HIDS_REPORT,
			       BT_GATT_CHRC_READ | BT_GATT_CHRC_NOTIFY,
			       SAMPLE_BT_PERM_READ,
			       read_input_report, NULL, NULL),
	BT_GATT_CCC(input_ccc_changed,
		    SAMPLE_BT_PERM_READ | SAMPLE_BT_PERM_WRITE),
	BT_GATT_DESCRIPTOR(BT_UUID_HIDS_REPORT_REF, BT_GATT_PERM_READ,
			   read_report, NULL, &input),
	BT_GATT_CHARACTERISTIC(BT_UUID_HIDS_CTRL_POINT,
			       BT_GATT_CHRC_WRITE_WITHOUT_RESP,
			       BT_GATT_PERM_WRITE,
			       NULL, write_ctrl_point, &ctrl_point),
);

#define SW0_NODE DT_ALIAS(sw0)

/* HID Report:
 * Byte 0: buttons (lower 3 bits)
 * Byte 1: X axis (int8)
 * Byte 2: Y axis (int8)
 */
int8_t report[3] = {0, 0, 0};

static void handler(struct k_work *work)
{
	const struct gpio_dt_spec sw0 = GPIO_DT_SPEC_GET(SW0_NODE, gpios);

	gpio_pin_configure_dt(&sw0, GPIO_INPUT);

    if (simulate_input) {

        report[0] = 0;

        if (gpio_pin_get_dt(&sw0)) {
            report[0] |= BIT(0);
        }

        bt_gatt_notify(NULL, &hog_svc.attrs[5],
				       report, sizeof(report));
    }
}


struct k_work work = Z_WORK_INITIALIZER(handler);


void hog_init(void)
{
}

void
hog_update_xy(int8_t x, int8_t y)
{
    report[1] = x;
    report[2] = y;

    k_work_submit(&work);
}
```

## src/hog.h
```c
/** @file
 *  @brief HoG Service sample
 */

/*
 * Copyright (c) 2016 Intel Corporation
 *
 * SPDX-License-Identifier: Apache-2.0
 */

#ifdef __cplusplus
extern "C" {
#endif

void hog_init(void);

void hog_button_loop(void);


void
hog_update_xy(int8_t x, int8_t y);


#ifdef __cplusplus
}
#endif
```
